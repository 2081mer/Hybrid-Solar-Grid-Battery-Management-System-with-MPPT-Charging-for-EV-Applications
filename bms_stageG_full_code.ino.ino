/*
  Hybrid Solar-Grid BMS - Stage G Full
  ------------------------------------
  Complete firmware:
    • P&O MPPT + CC-CV charging (3S)
    • Source selection with hysteresis (Solar preferred, Grid fallback)
    • Emergency logic (energize-to-run)
    • Arduino IoT Cloud skeleton
    • All previous protections, calibration, LCD, serial control

  Serial Monitor: 115200 baud, Newline
  Main commands:
    rc / ro          force solar path close/open
    e / x            enable / disable converter drivers
    p                start / stop auto charge (MPPT+CC-CV)
    src auto|solar|grid|none   set source mode
    icc / vcv / iterm          charge profile
    r / c / z / clr / h        report, stream, zero, clear, help
*/

#include <Wire.h>
#include <LiquidCrystal_I2C.h>
#include <Preferences.h>
#include "driver/mcpwm.h"

// ---------- Optional IoT Cloud (uncomment when ready) ----------
// #define USE_IOT_CLOUD
#ifdef USE_IOT_CLOUD
  #include "thingProperties.h"          // generated by Arduino IoT Cloud
#endif

// -------------------- Pin map (identical to all previous stages) --------------------
const int PIN_HIN_A = 18, PIN_LIN_A = 19;
const int PIN_HIN_B = 21, PIN_LIN_B = 22;
const int PIN_SD    = 23;                   // HIGH = drivers OFF
const int PIN_LCD_SDA = 16, PIN_LCD_SCL = 17;
const int PIN_BUZZ  = 4;
const int PIN_RLY_SOLAR = 25;
const int PIN_RLY_GRID  = 26;
const int PIN_RLY_LOAD  = 27;
const int PIN_RLY_EMERG = 14;               // energize-to-run

const int PIN_V_PANEL = 34;
const int PIN_V_PACK  = 35;
const int PIN_V_MID   = 36, PIN_V_LOW = 39;
const int PIN_I_PANEL = 32;
const int PIN_I_BATT  = 33;

// -------------------- Converter --------------------
const uint32_t PWM_FREQ_HZ = 50000;
const float DUTY_MAX   = 0.95f;
const float DUTY_MIN_B = 0.05f;
const float M_MAX = 3.0f;
const float M_MIN = 0.05f;

// -------------------- Charge profile (3S) --------------------
float I_CC   = 1.50f;
float V_CV   = 12.60f;
float I_TERM = 0.15f;
const float V_PACK_ABS_MAX = 12.80f;

// -------------------- Protections --------------------
const float V_IN_MIN  = 3.5f;
const float V_IN_TRIP = 28.0f;
const float I_IN_TRIP = 4.0f;
const float I_OUT_TRIP = 4.0f;

const float ACS_DIV  = 1.5f;
const float ACS_SENS = 0.100f;

// -------------------- P&O --------------------
float poStep = 0.015f;
const uint32_t PO_PERIOD_MS = 180;

// -------------------- Source selection (hysteresis) --------------------
enum SourceMode { SRC_AUTO, SRC_SOLAR, SRC_GRID, SRC_NONE };
SourceMode sourceMode = SRC_AUTO;

enum ActiveSource { ACT_NONE, ACT_SOLAR, ACT_GRID };
ActiveSource activeSource = ACT_NONE;

const float SOLAR_VIN_MIN     = 8.0f;     // below this → solar unusable
const float SOLAR_PIN_MIN     = 3.0f;     // W – minimum useful power
const uint32_t SOLAR_HOLD_MS  = 15000;    // must be good this long to switch to solar
const uint32_t GRID_HOLD_MS   = 8000;     // must be bad this long to leave solar

// -------------------- Objects --------------------
LiquidCrystal_I2C lcd(0x27, 16, 2);
Preferences prefs;

// -------------------- State --------------------
float kPanel=8.75f, kPack=5.0f, kMid=5.0f, kLow=5.0f;
float zeroPanelV=2.5f, zeroBattV=2.5f;

float vIn=0, iIn=0, vOut=0, iOut=0, pIn=0, pInPrev=0;
float ratioM=0.25f, dutyA=0, dutyB=0;
int   poDir = +1;

bool enabled=false, autoRun=false, tripped=false;
String tripReason="";
enum ChargeState { ST_IDLE, ST_BULK, ST_ABSORB, ST_FULL, ST_FAULT };
ChargeState chgState = ST_IDLE;

uint32_t dtUnits=5;
uint32_t timeoutMs=300000;          // 5 min default
bool streaming=false;
int  buzzMode=0;

uint32_t solarGoodSince=0, solarBadSince=0;
uint32_t lastSrcChange=0;

String lineBuf;
uint32_t lastCmdMs=0, tPo=0, tSlow=0, tLcd=0, tStream=0, tSrc=0;

// =================================================================
//  Low-level helpers
// =================================================================
float readVolts(int pin, int n=28) {
  uint32_t sum=0;
  for(int i=0;i<n;i++) sum += analogReadMilliVolts(pin);
  return (sum/(float)n)/1000.0f;
}
float readAcsVolts(int pin, int n=40) { return readVolts(pin,n)*ACS_DIV; }
float readAmps(int pin, float z, int n=40) { return (readAcsVolts(pin,n)-z)/ACS_SENS; }

void zeroCurrentSensors() {
  zeroPanelV = readAcsVolts(PIN_I_PANEL);
  zeroBattV  = readAcsVolts(PIN_I_BATT);
  Serial.printf("Zero: Iin %.3f V  Iout %.3f V\n", zeroPanelV, zeroBattV);
}

void calibrate(const char* name, int pin, float trueV, float& k, const char* key) {
  float vp = readVolts(pin,64);
  if(vp < 0.05f || trueV <= 0) { Serial.printf("%s pin too low\n", name); return; }
  k = trueV / vp;
  prefs.putFloat(key, k);
  Serial.printf("%s = %.4f (saved)\n", name, k);
}

// =================================================================
//  PWM
// =================================================================
void applyDeadTime() {
  mcpwm_deadtime_enable(MCPWM_UNIT_0, MCPWM_TIMER_0, MCPWM_ACTIVE_HIGH_COMPLIMENT_MODE, dtUnits, dtUnits);
  mcpwm_deadtime_enable(MCPWM_UNIT_0, MCPWM_TIMER_1, MCPWM_ACTIVE_HIGH_COMPLIMENT_MODE, dtUnits, dtUnits);
}

void pwmInit() {
  mcpwm_gpio_init(MCPWM_UNIT_0, MCPWM0A, PIN_HIN_A);
  mcpwm_gpio_init(MCPWM_UNIT_0, MCPWM0B, PIN_LIN_A);
  mcpwm_gpio_init(MCPWM_UNIT_0, MCPWM1A, PIN_HIN_B);
  mcpwm_gpio_init(MCPWM_UNIT_0, MCPWM1B, PIN_LIN_B);
  mcpwm_config_t cfg={};
  cfg.frequency = PWM_FREQ_HZ;
  cfg.cmpr_a=0; cfg.cmpr_b=0;
  cfg.counter_mode = MCPWM_UP_COUNTER;
  cfg.duty_mode = MCPWM_DUTY_MODE_0;
  mcpwm_init(MCPWM_UNIT_0, MCPWM_TIMER_0, &cfg);
  mcpwm_init(MCPWM_UNIT_0, MCPWM_TIMER_1, &cfg);
  applyDeadTime();
}

void setLegDuty(mcpwm_timer_t t, float frac) {
  float pct = constrain(frac,0.0f,1.0f)*100.0f;
  mcpwm_set_duty(MCPWM_UNIT_0, t, MCPWM_OPR_A, pct);
  mcpwm_set_duty_type(MCPWM_UNIT_0, t, MCPWM_OPR_A, MCPWM_DUTY_MODE_0);
}

void applyRatio(float M) {
  M = constrain(M, M_MIN, M_MAX);
  if(M <= 1.0f) { dutyB = DUTY_MAX; dutyA = DUTY_MAX * M; }
  else           { dutyA = DUTY_MAX; dutyB = DUTY_MAX / M; }
  dutyA = constrain(dutyA, 0.0f, DUTY_MAX);
  dutyB = constrain(dutyB, DUTY_MIN_B, DUTY_MAX);
  setLegDuty(MCPWM_TIMER_0, dutyA);
  setLegDuty(MCPWM_TIMER_1, dutyB);
  ratioM = M;
}

// =================================================================
//  Relay helpers (with hard interlock)
// =================================================================
void setSolar(bool on) {
  if(on && digitalRead(PIN_RLY_GRID)) {
    digitalWrite(PIN_RLY_GRID, LOW);          // force grid off first
    delay(30);
  }
  digitalWrite(PIN_RLY_SOLAR, on ? HIGH : LOW);
}

void setGrid(bool on) {
  if(on && digitalRead(PIN_RLY_SOLAR)) {
    digitalWrite(PIN_RLY_SOLAR, LOW);
    delay(30);
  }
  digitalWrite(PIN_RLY_GRID, on ? HIGH : LOW);
}

void setEmerg(bool on) {
  digitalWrite(PIN_RLY_EMERG, on ? HIGH : LOW);
}

void allSourcesOff() {
  setSolar(false);
  setGrid(false);
  setEmerg(false);
  activeSource = ACT_NONE;
}

// =================================================================
//  Drivers & trips
// =================================================================
void driversDisable() {
  digitalWrite(PIN_SD, HIGH);
  enabled = false;
  autoRun = false;
  applyRatio(0);
  if(chgState != ST_FAULT) chgState = ST_IDLE;
}

void trip(const char* reason) {
  driversDisable();
  allSourcesOff();
  tripped = true;
  chgState = ST_FAULT;
  tripReason = reason;
  buzzMode = 1;
  Serial.printf("TRIP: %s\n", reason);
}

void driversEnable() {
  if(tripped) {
    Serial.printf("Tripped (%s). clr first\n", tripReason.c_str());
    return;
  }
  if(activeSource != ACT_SOLAR) {
    Serial.println(F("Solar source not active – cannot enable converter"));
    return;
  }
  vIn = readVolts(PIN_V_PANEL) * kPanel;
  if(vIn < V_IN_MIN) {
    Serial.printf("Vin too low (%.2f V)\n", vIn);
    return;
  }
  applyRatio(0.18f);
  delay(20);
  digitalWrite(PIN_SD, LOW);
  enabled = true;
  delay(60);
  pInPrev = 0;
  poDir = +1;
  chgState = ST_BULK;
  Serial.println(F("Drivers ENABLED"));
}

// =================================================================
//  Source selection with hysteresis
// =================================================================
bool solarIsGood() {
  return (vIn > SOLAR_VIN_MIN) && (pIn > SOLAR_PIN_MIN);
}

void sourceManager() {
  if(sourceMode == SRC_NONE) {
    allSourcesOff();
    return;
  }

  uint32_t now = millis();
  bool good = solarIsGood();

  if(good) {
    if(solarGoodSince == 0) solarGoodSince = now;
    solarBadSince = 0;
  } else {
    if(solarBadSince == 0) solarBadSince = now;
    solarGoodSince = 0;
  }

  ActiveSource desired = ACT_NONE;

  if(sourceMode == SRC_SOLAR) {
    desired = ACT_SOLAR;
  } else if(sourceMode == SRC_GRID) {
    desired = ACT_GRID;
  } else { // SRC_AUTO
    if(activeSource == ACT_SOLAR) {
      // stay on solar until it has been bad for GRID_HOLD_MS
      if(solarBadSince && (now - solarBadSince > GRID_HOLD_MS))
        desired = ACT_GRID;
      else
        desired = ACT_SOLAR;
    } else {
      // currently on grid or none → switch to solar only after SOLAR_HOLD_MS of good power
      if(solarGoodSince && (now - solarGoodSince > SOLAR_HOLD_MS))
        desired = ACT_SOLAR;
      else
        desired = ACT_GRID;
    }
  }

  // Apply change
  if(desired != activeSource) {
    // Always open both sources first
    setSolar(false);
    setGrid(false);
    delay(40);

    if(desired == ACT_SOLAR) {
      setSolar(true);
      setEmerg(true);
      activeSource = ACT_SOLAR;
      Serial.println(F("SOURCE → SOLAR"));
    } else if(desired == ACT_GRID) {
      setGrid(true);
      setEmerg(true);
      activeSource = ACT_GRID;
      // Converter must be off when on grid
      driversDisable();
      Serial.println(F("SOURCE → GRID"));
    } else {
      setEmerg(false);
      activeSource = ACT_NONE;
      driversDisable();
      Serial.println(F("SOURCE → NONE"));
    }
    lastSrcChange = now;
  }
}

// =================================================================
//  MPPT + CC-CV (only active when source == SOLAR and enabled)
// =================================================================
void controlTick() {
  if(!enabled || !autoRun || activeSource != ACT_SOLAR) return;

  vIn  = readVolts(PIN_V_PANEL,18) * kPanel;
  iIn  = readAmps(PIN_I_PANEL, zeroPanelV, 24);
  vOut = readVolts(PIN_V_PACK, 18) * kPack;
  iOut = readAmps(PIN_I_BATT,  zeroBattV, 24);
  pIn  = vIn * iIn;

  // Hard trips
  if(vOut > V_PACK_ABS_MAX) { trip("Pack OV"); return; }
  if(vIn  < V_IN_MIN)       { trip("Vin UV");  return; }
  if(vIn  > V_IN_TRIP)      { trip("Vin OV");  return; }
  if(fabsf(iIn)  > I_IN_TRIP)  { trip("Iin OC"); return; }
  if(fabsf(iOut) > I_OUT_TRIP) { trip("Iout OC"); return; }

  // Phase machine
  if(chgState == ST_BULK && vOut >= V_CV - 0.05f) chgState = ST_ABSORB;
  if(chgState == ST_ABSORB && iOut < I_TERM && vOut >= V_CV - 0.10f) {
    chgState = ST_FULL;
    autoRun = false;
    applyRatio(0);
    Serial.println(F("Charge COMPLETE"));
    return;
  }

  // P&O with CC/CV priority
  int dir = poDir;
  if(pIn < pInPrev) dir = -poDir;

  bool canIncrease = (iOut < I_CC * 0.97f) && (vOut < V_CV * 0.993f);
  if(dir > 0 && !canIncrease) dir = -1;

  float nextM = constrain(ratioM + dir * poStep, M_MIN, M_MAX);
  applyRatio(nextM);
  poDir = dir;
  pInPrev = pIn;
}

// =================================================================
//  Slow tasks
// =================================================================
void slowTick() {
  // Update measurements for display / source decision
  float v = readVolts(PIN_V_PANEL,12) * kPanel;
  vIn = (vIn==0) ? v : 0.65f*vIn + 0.35f*v;
  iIn  = readAmps(PIN_I_PANEL, zeroPanelV, 16);
  vOut = readVolts(PIN_V_PACK,12) * kPack;
  iOut = readAmps(PIN_I_BATT,  zeroBattV, 16);
  pIn  = vIn * iIn;

  sourceManager();

  if(enabled && (millis() - lastCmdMs > timeoutMs)) {
    driversDisable();
    Serial.println(F("TIMEOUT"));
  }
}

// =================================================================
//  Serial / LCD / IoT
// =================================================================
const char* srcStr() {
  switch(activeSource) {
    case ACT_SOLAR: return "SOL";
    case ACT_GRID:  return "GRD";
    default:        return "---";
  }
}
const char* chgStr() {
  switch(chgState) {
    case ST_BULK:   return "BULK";
    case ST_ABSORB: return "ABS ";
    case ST_FULL:   return "FULL";
    case ST_FAULT:  return "FLT ";
    default:        return "IDLE";
  }
}

void printReport() {
  Serial.println(F("========== Stage G =========="));
  Serial.printf("Source: %s (mode %s) | Drivers %s | Auto %s | %s\n",
      srcStr(),
      sourceMode==SRC_AUTO?"AUTO":sourceMode==SRC_SOLAR?"SOLAR":sourceMode==SRC_GRID?"GRID":"NONE",
      enabled?"ON":"off", autoRun?"RUN":"stop", chgStr());
  Serial.printf("M %.3f  Pin %.1f W  |  Pack %.2f V  %.2f A\n", ratioM, pIn, vOut, iOut);
  Serial.printf("Icc=%.2f  Vcv=%.2f  Iterm=%.2f\n", I_CC, V_CV, I_TERM);
  if(tripped) Serial.printf("TRIPPED: %s\n", tripReason.c_str());
}

void printHelp() {
  Serial.println(F("rc/ro  e/x  p  src auto|solar|grid|none"));
  Serial.println(F("icc <A>  vcv <V>  iterm <A>  s <step>"));
  Serial.println(F("r  c  z  clr  t <s>  dt <n>  kp/kk/...  h"));
}

void processCommand(String cmd) {
  cmd.trim(); cmd.toLowerCase();
  if(cmd.length()==0) return;

  if     (cmd=="rc")  { setSolar(true); setEmerg(true); activeSource=ACT_SOLAR; Serial.println(F("Forced SOLAR")); }
  else if(cmd=="ro")  { allSourcesOff(); Serial.println(F("All sources OPEN")); }
  else if(cmd=="e")   driversEnable();
  else if(cmd=="x")   { driversDisable(); Serial.println(F("Drivers OFF")); }
  else if(cmd=="p")   {
    if(activeSource != ACT_SOLAR) { Serial.println(F("Need solar source first")); return; }
    if(!enabled) { Serial.println(F("Enable drivers first")); return; }
    autoRun = !autoRun;
    if(autoRun) { chgState=ST_BULK; pInPrev=0; poDir=+1; Serial.println(F("Charge STARTED")); }
    else        Serial.println(F("Charge STOPPED"));
  }
  else if(cmd.startsWith("src ")) {
    String m = cmd.substring(4);
    if     (m=="auto")  { sourceMode=SRC_AUTO;  Serial.println(F("Source mode AUTO")); }
    else if(m=="solar") { sourceMode=SRC_SOLAR; Serial.println(F("Source mode SOLAR")); }
    else if(m=="grid")  { sourceMode=SRC_GRID;  Serial.println(F("Source mode GRID")); }
    else if(m=="none")  { sourceMode=SRC_NONE;  Serial.println(F("Source mode NONE")); }
  }
  else if(cmd=="r")   printReport();
  else if(cmd=="c")   { streaming=!streaming; Serial.printf("Stream %s\n", streaming?"on":"off"); }
  else if(cmd=="z")   { if(enabled) Serial.println(F("Disable first")); else zeroCurrentSensors(); }
  else if(cmd=="clr") { tripped=false; tripReason=""; buzzMode=0; chgState=ST_IDLE; Serial.println(F("Cleared")); }
  else if(cmd=="h")   printHelp();
  else if(cmd.startsWith("icc "))  { float v=cmd.substring(4).toFloat(); if(v>0.2f&&v<=3.5f){I_CC=v; prefs.putFloat("I_CC",v); Serial.printf("I_CC=%.2f\n",v);} }
  else if(cmd.startsWith("vcv "))  { float v=cmd.substring(4).toFloat(); if(v>=11.5f&&v<=12.65f){V_CV=v; prefs.putFloat("V_CV",v); Serial.printf("V_CV=%.2f\n",v);} }
  else if(cmd.startsWith("iterm ")){ float v=cmd.substring(6).toFloat(); if(v>0.05f&&v<1.0f){I_TERM=v; prefs.putFloat("I_TERM",v); Serial.printf("I_TERM=%.2f\n",v);} }
  else if(cmd.startsWith("s "))    { float s=cmd.substring(2).toFloat(); if(s>0.005f&&s<0.06f){poStep=s; Serial.printf("step=%.3f\n",s);} }
  else if(cmd.startsWith("t "))    { long s=cmd.substring(2).toInt(); if(s>=30&&s<=900){timeoutMs=s*1000UL; Serial.printf("timeout %ld s\n",s);} }
  else if(cmd.startsWith("dt "))   { long n=cmd.substring(3).toInt(); if(!enabled && n>=1&&n<=50){dtUnits=n; applyDeadTime(); Serial.printf("dt %ld\n",n);} }
  else if(cmd.startsWith("kp "))   calibrate("Panel", PIN_V_PANEL, cmd.substring(3).toFloat(), kPanel, "kPanel");
  else if(cmd.startsWith("kk "))   calibrate("Pack",  PIN_V_PACK,  cmd.substring(3).toFloat(), kPack,  "kPack");
  else if(cmd.startsWith("km "))   calibrate("Mid",   PIN_V_MID,   cmd.substring(3).toFloat(), kMid,   "kMid");
  else if(cmd.startsWith("kl "))   calibrate("Low",   PIN_V_LOW,   cmd.substring(3).toFloat(), kLow,   "kLow");
  else Serial.println(F("Unknown – h"));
}

void handleSerial() {
  while(Serial.available()) {
    char c = Serial.read();
    lastCmdMs = millis();
    if(c=='\r') continue;
    if(c=='\n') { processCommand(lineBuf); lineBuf=""; }
    else if(lineBuf.length()<48) lineBuf += c;
  }
}

void updateLcd() {
  if(millis()-tLcd < 400) return;
  tLcd = millis();
  char l0[17], l1[17];
  snprintf(l0, sizeof(l0), "%s %s %4.1fW", srcStr(), chgStr(), pIn);
  snprintf(l1, sizeof(l1), "%.1fV %.2fA %s", vOut, iOut, enabled?"ON":"OF");
  lcd.setCursor(0,0); lcd.print(l0);
  lcd.setCursor(0,1); lcd.print(l1);
}

#ifdef USE_IOT_CLOUD
void updateIoT() {
  // Map your cloud variables here (examples)
  // vin = vIn;
  // vpack = vOut;
  // iin = iIn;
  // iout = iOut;
  // pin = pIn;
  // source = String(srcStr());
  // chargeState = String(chgStr());
  // etc.
}
#endif

// =================================================================
//  Setup / Loop
// =================================================================
void setup() {
  digitalWrite(PIN_SD, HIGH);
  pinMode(PIN_SD, OUTPUT);
  digitalWrite(PIN_SD, HIGH);

  const int outs[] = {PIN_RLY_SOLAR, PIN_RLY_GRID, PIN_RLY_LOAD, PIN_RLY_EMERG, PIN_BUZZ};
  for(int p : outs) { pinMode(p, OUTPUT); digitalWrite(p, LOW); }

  Serial.begin(115200);
  delay(400);
  Serial.println(F("\n=== BMS Stage G Full ==="));
  Serial.println(F("Solar/Grid + MPPT + CC-CV + Emergency"));

  analogReadResolution(12);
  analogSetAttenuation(ADC_11db);

  prefs.begin("bms", false);
  kPanel = prefs.getFloat("kPanel", kPanel);
  kPack  = prefs.getFloat("kPack",  kPack);
  kMid   = prefs.getFloat("kMid",   kMid);
  kLow   = prefs.getFloat("kLow",   kLow);
  I_CC   = prefs.getFloat("I_CC",   I_CC);
  V_CV   = prefs.getFloat("V_CV",   V_CV);
  I_TERM = prefs.getFloat("I_TERM", I_TERM);

  Wire.begin(PIN_LCD_SDA, PIN_LCD_SCL);
  lcd.init();
  lcd.backlight();
  lcd.print("Stage G Full");
  lcd.setCursor(0,1); lcd.print("Solar/Grid BMS");

  pwmInit();
  applyRatio(0);
  zeroCurrentSensors();

#ifdef USE_IOT_CLOUD
  initProperties();
  ArduinoCloud.begin(ArduinoIoTPreferredConnection);
  setDebugMessageLevel(2);
  ArduinoCloud.printDebugInfo();
#endif

  lastCmdMs = millis();
  printHelp();
}

void loop() {
  handleSerial();

  uint32_t now = millis();
  if(now - tPo   >= PO_PERIOD_MS) { tPo = now; controlTick(); }
  if(now - tSlow >= 60)           { tSlow = now; slowTick(); }
  updateLcd();
  digitalWrite(PIN_BUZZ, buzzMode==1 ? HIGH : LOW);

  if(streaming && now - tStream >= 1000) {
    tStream = now;
    printReport();
  }

#ifdef USE_IOT_CLOUD
  ArduinoCloud.update();
  updateIoT();
#endif
}